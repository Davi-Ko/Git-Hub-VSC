#include <ESP8266WiFi.h>
#include <ESP8266WebServer.h>
#include <ESP8266HTTPClient.h>
#include <FS.h>

// Wifi generated by the ESP-01
const char* ssidAP = "Relay_2";
const char* passwordAP = "abc12345";

// IP of this relay
IPAddress local_ip(192, 168, 4, 3);
IPAddress gateway(192, 168, 4, 1);
IPAddress subnet(255, 255, 255, 0); 

// Configuration of the Wifi from the other ESP-01
const char* ssidClient = "Relay_1";
const char* passwordClient = "abc12345";
const char* serverIP = "192.168.4.2";

// Creating the WebServer
ESP8266WebServer server(80);

// Defining the pin of the ESP-01 that will command the relay
const int relayPin = 0;

// Manipula requisições CORS (Cross-Origin Resource Sharing)
void handleCORS() {
  server.sendHeader("Access-Control-Allow-Origin", "*");
  server.sendHeader("Access-Control-Allow-Methods", "GET, POST, OPTIONS");
  server.sendHeader("Access-Control-Allow-Headers", "Content-Type");
}

// Relay Configuration
void setup() {
    Serial.begin(115200);

    pinMode(relayPin, OUTPUT);
    digitalWrite(relayPin, HIGH);

    // Initializes the sistem SPIFFS
    if (!SPIFFS.begin()) {
        Serial.println("Falha ao inicializar SPIFFS!");
        return;
    }

    // Configures this relay as Access Point
    WiFi.softAP(ssidAP, passwordAP);
    WiFi.softAPConfig(local_ip, gateway, subnet);

    // Makes this relay to connect to the other one as a Client
    Serial.print("Connecting to Relay 1...");
    
    WiFi.begin(ssidClient, passwordClient);
    while (WiFi.status() != WL_CONNECTED) {
        delay(500);
        Serial.print(".");
    }
    Serial.println("\nConnection Success!");

    // Confirmation of this relay IP
    Serial.print("Relay 2 AP IP: ");
    Serial.println(WiFi.softAPIP());

    Serial.print("Relay 1 Client IP: ");
    Serial.println(WiFi.localIP());

    // API para verificar conexão
    server.on("/api", HTTP_GET, []() {
        handleCORS();
        if (WiFi.status() == WL_CONNECTED) {
            server.send(200, "text/plain", "Connected!");
        } else {
            server.send(200, "text/plain", "Retrying connection...");
        }
    });

    // API para controlar o relay
    server.on("/ON", HTTP_GET, []() {
        handleCORS();
        digitalWrite(relayPin, LOW);
        server.send(200, "text/plain", "Relay power: ON");
    });
    
    server.on("/OFF", HTTP_GET, []() {
        handleCORS();
        digitalWrite(relayPin, HIGH);
        server.send(200, "text/plain", "Relay power: OFF");
    });

    server.on("/status", HTTP_GET, []() {
        handleCORS();
        String status = (digitalRead(relayPin) == LOW) ? "ON" : "OFF";
        server.send(200, "text/plain", "Relay Status: " + status);
    });

    // Tratamento da rota raiz para servir o arquivo index.html
    server.on("/", HTTP_GET, []() {
        File file = SPIFFS.open("/index.html", "r");
        if (!file) {
            server.send(404, "text/plain", "Arquivo não encontrado");
            return;
        }
        server.streamFile(file, "text/html");
        file.close();
    });

    // Gets the CSS file
    server.on("/style.css", HTTP_GET, []() {
        File file = SPIFFS.open("/style.css", "r");
        if (!file) {
            server.send(404, "text/plain", "Arquivo não encontrado");
            return;
        }
        server.streamFile(file, "text/css");
        file.close();
    });

    // Gets the JS file
    server.on("/script.js", HTTP_GET, []() {
        File file = SPIFFS.open("/script.js", "r");
        if (!file) {
            server.send(404, "text/plain", "Arquivo não encontrado");
            return;
        }
        server.streamFile(file, "application/javascript");
        file.close();
    });

    // Tratamento de requisições OPTIONS para CORS
    server.on("/", HTTP_OPTIONS, []() {
        handleCORS();
        server.send(204);
    });
    server.on("/ON", HTTP_OPTIONS, []() {
        handleCORS();
        server.send(204);
    });
    server.on("/OFF", HTTP_OPTIONS, []() {
        handleCORS();
        server.send(204);
    });
    server.on("/status", HTTP_OPTIONS, []() {
        handleCORS();
        server.send(204);
    });

    server.begin();
    Serial.println("Servidor HTTP iniciado");
}

// Keeps receiving the requests of new clients and reconnecting Wi-Fi if connection lost
void loop() {
    server.handleClient();

    if (WiFi.status() != WL_CONNECTED) {
        Serial.println("Lost connection! Trying to reconnect...");
        WiFi.begin(ssidClient, passwordClient);
    }
}